## drivers/Kconfig
```kconfig
# SPDX-License-Identifier: GPL-2.0
menu "Device Drivers"

# Keep I/O buses first

source "drivers/amba/Kconfig"
source "drivers/pci/Kconfig"
source "drivers/rapidio/Kconfig"

config PC104
	bool "PC/104 support" if EXPERT
	help
	  Expose PC/104 form factor device drivers and options available for
	  selection and configuration. Enable this option if your target
	  machine has a PC/104 bus.

source "drivers/base/Kconfig"

source "drivers/bus/Kconfig"

source "drivers/cache/Kconfig"

source "drivers/connector/Kconfig"

source "drivers/firmware/Kconfig"



source "drivers/mtd/Kconfig"

source "drivers/of/Kconfig"


source "drivers/pnp/Kconfig"

source "drivers/block/Kconfig"

source "drivers/nvme/Kconfig"

source "drivers/misc/Kconfig"

source "drivers/scsi/Kconfig"

source "drivers/ata/Kconfig"

source "drivers/md/Kconfig"

source "drivers/target/Kconfig"

source "drivers/message/fusion/Kconfig"


source "drivers/net/Kconfig"

# input before char - char/joystick depends on it. As does USB.

source "drivers/input/Kconfig"

source "drivers/char/Kconfig"

source "drivers/i2c/Kconfig"

source "drivers/i3c/Kconfig"

source "drivers/spi/Kconfig"

source "drivers/spmi/Kconfig"



source "drivers/ptp/Kconfig"


source "drivers/pinctrl/Kconfig"

source "drivers/gpio/Kconfig"


source "drivers/power/Kconfig"

source "drivers/hwmon/Kconfig"

source "drivers/thermal/Kconfig"

source "drivers/watchdog/Kconfig"



source "drivers/mfd/Kconfig"

source "drivers/regulator/Kconfig"


source "drivers/video/Kconfig"




source "drivers/usb/Kconfig"

source "drivers/mmc/Kconfig"

source "drivers/ufs/Kconfig"


source "drivers/leds/Kconfig"



source "drivers/edac/Kconfig"

source "drivers/rtc/Kconfig"

source "drivers/dma/Kconfig"

source "drivers/dma-buf/Kconfig"



source "drivers/vfio/Kconfig"

source "drivers/virt/Kconfig"

source "drivers/virtio/Kconfig"

source "drivers/vdpa/Kconfig"

source "drivers/vhost/Kconfig"

source "drivers/hv/Kconfig"

source "drivers/xen/Kconfig"




source "drivers/platform/Kconfig"

source "drivers/clk/Kconfig"

source "drivers/hwspinlock/Kconfig"

source "drivers/clocksource/Kconfig"

source "drivers/mailbox/Kconfig"

source "drivers/iommu/Kconfig"

source "drivers/remoteproc/Kconfig"

source "drivers/rpmsg/Kconfig"


source "drivers/soc/Kconfig"

source "drivers/pmdomain/Kconfig"

source "drivers/devfreq/Kconfig"


source "drivers/memory/Kconfig"



source "drivers/pwm/Kconfig"

source "drivers/irqchip/Kconfig"


source "drivers/reset/Kconfig"

source "drivers/phy/Kconfig"

source "drivers/powercap/Kconfig"


source "drivers/perf/Kconfig"

source "drivers/ras/Kconfig"


source "drivers/android/Kconfig"

source "drivers/nvdimm/Kconfig"

source "drivers/dax/Kconfig"

source "drivers/nvmem/Kconfig"




source "drivers/tee/Kconfig"

source "drivers/mux/Kconfig"

source "drivers/opp/Kconfig"



source "drivers/interconnect/Kconfig"



source "drivers/peci/Kconfig"



source "drivers/resctrl/Kconfig"

endmenu
```

## kernel/bpf/Kconfig.rust
```kconfig
# SPDX-License-Identifier: GPL-2.0-only

# Configuration options for Rust BPF map implementations.
# Provides a mutually exclusive choice between C and Rust implementations
# of BPF map data structures.

choice
	prompt "BPF map implementation language"
	depends on BPF_SYSCALL
	default BPF_C_MAPS
	help
	  Select the implementation language for BPF map data structures.
	  The Rust implementation provides memory safety guarantees through
	  Rust's ownership model and type system while maintaining functional
	  equivalence with the C implementation.

config BPF_C_MAPS
	bool "C implementation (default)"
	help
	  Use the traditional C implementation of BPF map data structures.
	  This is the default and well-tested implementation.

config BPF_RUST_MAPS
	bool "Rust implementation"
	depends on RUST
	help
	  Use the Rust implementation of BPF map data structures.
	  This provides compile-time memory safety guarantees including
	  protection against use-after-free, double-free, and buffer
	  overflow vulnerabilities.

	  The Rust implementation requires the Rust toolchain (rustc) to
	  be available and CONFIG_RUST to be enabled.

	  If unsure, say N.

endchoice
```

## net/quic/Kconfig
```kconfig
# SPDX-License-Identifier: GPL-2.0-only

menuconfig QUIC
	tristate "QUIC protocol support"
	depends on INET
	select CRYPTO
	select CRYPTO_AES
	select CRYPTO_GCM
	select CRYPTO_SHA256
	select CRYPTO_HMAC
	help
	  QUIC (RFC 9000) is a UDP-based multiplexed and secure transport
	  protocol. This option enables QUIC protocol support in the kernel.

	  If unsure, say N.

if QUIC

config TQUIC
	bool "TQUIC multi-path support for WAN bonding"
	default y
	help
	  Enable TQUIC extensions for multi-path transmission over multiple
	  WAN interfaces. This allows bonding multiple network connections
	  (e.g., Ethernet + Cellular) for increased bandwidth and reliability.

	  If unsure, say Y.

config TQUIC_SCHEDULER_ROUNDROBIN
	bool "Round-robin scheduler"
	default y
	depends on TQUIC
	help
	  Round-robin packet scheduler distributes packets evenly across
	  all available paths.

config TQUIC_SCHEDULER_WEIGHTED
	bool "Weighted scheduler"
	default y
	depends on TQUIC
	help
	  Weighted scheduler distributes packets based on configured
	  weights for each path.

config TQUIC_SCHEDULER_LOWLATENCY
	bool "Low-latency scheduler"
	default y
	depends on TQUIC
	help
	  Low-latency scheduler always selects the path with the
	  lowest measured RTT.

config TQUIC_SCHEDULER_REDUNDANT
	bool "Redundant scheduler"
	default y
	depends on TQUIC
	help
	  Redundant scheduler sends packets on multiple paths
	  for maximum reliability.

config TQUIC_SCHEDULER_ADAPTIVE
	bool "Adaptive scheduler"
	default y
	depends on TQUIC
	help
	  Adaptive scheduler dynamically adjusts path selection
	  based on current network conditions.

config QUIC_DEBUG
	bool "QUIC debugging"
	depends on QUIC
	help
	  Enable QUIC debugging output. This creates entries in debugfs
	  for inspecting QUIC connection state.

endif # QUIC
```

## net/tquic/Kconfig
```kconfig
# SPDX-License-Identifier: GPL-2.0-only
#
# TQUIC WAN Bonding configuration
#

menuconfig TQUIC
	tristate "TQUIC: WAN Bonding over QUIC"
	depends on INET
	select CRYPTO
	select CRYPTO_AES
	select CRYPTO_GCM
	select NET_UDP_TUNNEL
	help
	  TQUIC (Transport QUIC) provides WAN bonding capabilities using
	  the QUIC protocol. It enables aggregating multiple WAN connections
	  (such as LTE, 5G, WiFi, and wired links) into a single logical
	  connection with seamless failover and bandwidth aggregation.

	  TQUIC implements connection migration, multipath support, and
	  intelligent path selection to optimize throughput and reliability
	  across heterogeneous network links.

	  To compile this driver as a module, choose M here: the module
	  will be called tquic.

	  If unsure, say N.

if TQUIC

config TQUIC_CORE
	tristate "TQUIC Core Protocol"
	default y
	help
	  This provides the core TQUIC protocol implementation including
	  connection management, stream multiplexing, and the QUIC state
	  machine. This is required for all TQUIC functionality.

	  To compile this as a module, choose M here: the module will
	  be called tquic_core.

	  If unsure, say Y.

config TQUIC_WAN_BONDING
	tristate "TQUIC WAN Bonding Support"
	depends on TQUIC_CORE
	select DST_CACHE
	default y
	help
	  Enable WAN bonding support in TQUIC. This allows aggregating
	  multiple network paths into a single logical connection with
	  automatic failover and load balancing capabilities.

	  Features include:
	    - Multi-path aggregation across heterogeneous links
	    - Seamless connection migration between paths
	    - Intelligent path selection based on latency and bandwidth
	    - Automatic failover with sub-second recovery

	  To compile this as a module, choose M here: the module will
	  be called tquic_bond.

	  If unsure, say Y.

config TQUIC_PATH_MANAGER
	tristate "TQUIC Path Manager"
	depends on TQUIC_WAN_BONDING
	default y
	help
	  The TQUIC Path Manager handles discovery, monitoring, and
	  selection of network paths for WAN bonding. It provides
	  APIs for path probing, quality estimation, and dynamic
	  path management.

	  To compile this as a module, choose M here: the module will
	  be called tquic_pm.

	  If unsure, say Y.

config TQUIC_SCHEDULER
	tristate "TQUIC Packet Scheduler"
	depends on TQUIC_WAN_BONDING
	default y
	help
	  The TQUIC Packet Scheduler determines how packets are
	  distributed across available paths. It supports multiple
	  scheduling algorithms selectable at runtime.

	  To compile this as a module, choose M here: the module will
	  be called tquic_sched.

	  If unsure, say Y.

menuconfig TQUIC_CONG_ADVANCED
	bool "TQUIC: advanced congestion control"
	depends on TQUIC_CORE
	help
	  Support for selection of various TQUIC congestion control
	  modules optimized for multipath WAN scenarios.

	  The default congestion control algorithm is CUBIC, which
	  works well for most scenarios. Advanced users may want to
	  experiment with other algorithms for specific use cases.

	  If unsure, say N.

if TQUIC_CONG_ADVANCED

config TQUIC_CONG_CUBIC
	tristate "TQUIC CUBIC"
	default y
	help
	  CUBIC congestion control adapted for TQUIC multipath
	  environments. CUBIC uses a cubic function for window
	  growth which provides good performance across a wide
	  range of network conditions.

	  This is the default congestion control algorithm.

config TQUIC_CONG_BBR
	tristate "TQUIC BBR (Bottleneck Bandwidth and RTT)"
	default m
	help
	  BBR (Bottleneck Bandwidth and RTT) congestion control
	  adapted for TQUIC multipath environments. BBR attempts
	  to achieve high throughput while maintaining low latency
	  by estimating the available bandwidth and minimum RTT.

	  BBR works well on paths with varying characteristics
	  and is recommended for heterogeneous WAN bonding scenarios.

config TQUIC_CONG_COPA
	tristate "TQUIC Copa"
	default m
	help
	  Copa (Competitive Pacing Algorithm) is a delay-based
	  congestion control algorithm designed to achieve both
	  high throughput and low queuing delay. It is particularly
	  well-suited for real-time applications over bonded links.

config TQUIC_CONG_WESTWOOD
	tristate "TQUIC Westwood+"
	default m
	help
	  Westwood+ congestion control adapted for TQUIC. Westwood+
	  uses bandwidth estimation to improve performance over
	  wireless links where packet loss may not indicate congestion.

	  Recommended when bonding includes wireless/mobile paths.

endif # TQUIC_CONG_ADVANCED

choice
	prompt "Default TQUIC congestion control"
	default DEFAULT_TQUIC_CUBIC
	help
	  Select the default congestion control algorithm for TQUIC
	  connections. This can be overridden at runtime via sysctl
	  or socket options.

	config DEFAULT_TQUIC_CUBIC
		bool "CUBIC" if TQUIC_CONG_CUBIC=y || !TQUIC_CONG_ADVANCED

	config DEFAULT_TQUIC_BBR
		bool "BBR" if TQUIC_CONG_BBR=y

	config DEFAULT_TQUIC_COPA
		bool "Copa" if TQUIC_CONG_COPA=y

	config DEFAULT_TQUIC_WESTWOOD
		bool "Westwood+" if TQUIC_CONG_WESTWOOD=y

endchoice

config DEFAULT_TQUIC_CONG
	string
	default "cubic" if DEFAULT_TQUIC_CUBIC
	default "bbr" if DEFAULT_TQUIC_BBR
	default "copa" if DEFAULT_TQUIC_COPA
	default "westwood" if DEFAULT_TQUIC_WESTWOOD
	default "cubic"

config TQUIC_CRYPTO
	tristate "TQUIC Cryptographic Support"
	depends on TQUIC_CORE
	select CRYPTO_LIB_CHACHA20POLY1305
	select CRYPTO_LIB_AES
	default y
	help
	  Cryptographic support for TQUIC including TLS 1.3 handshake
	  and packet protection. This is required for secure TQUIC
	  connections.

	  To compile this as a module, choose M here: the module will
	  be called tquic_crypto.

	  If unsure, say Y.

config TQUIC_IPV6
	bool "TQUIC IPv6 support"
	depends on TQUIC_CORE
	depends on IPV6=y
	default y
	help
	  Enable IPv6 support for TQUIC connections. This allows
	  TQUIC to use IPv6 paths for WAN bonding alongside IPv4.

	  If unsure, say Y.

config TQUIC_DIAG
	tristate "TQUIC connection diagnostics"
	depends on TQUIC_CORE
	depends on INET_DIAG
	def_tristate INET_DIAG
	help
	  Support for TQUIC socket diagnostics via the sock_diag
	  netlink interface. This enables tools like ss to display
	  TQUIC connection information.

config TQUIC_DEBUGFS
	bool "TQUIC debugfs interface"
	depends on TQUIC_CORE
	depends on DEBUG_FS
	help
	  Export TQUIC debugging information via debugfs. This
	  includes per-connection statistics, path information,
	  and internal state for debugging purposes.

	  If unsure, say N.

config TQUIC_KUNIT_TEST
	tristate "TQUIC KUnit tests" if !KUNIT_ALL_TESTS
	depends on TQUIC_CORE
	depends on KUNIT
	default KUNIT_ALL_TESTS
	help
	  KUnit tests for the TQUIC subsystem covering core protocol
	  functionality, path management, and congestion control.

	  Only useful for kernel developers running KUnit test harness
	  and not for inclusion into a production build.

	  For more information on KUnit and unit tests in general,
	  refer to the KUnit documentation in Documentation/dev-tools/kunit/.

	  If unsure, say N.

endif # TQUIC
```
